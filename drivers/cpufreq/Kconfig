## drivers/cpufreq/Kconfig
```kconfig
# SPDX-License-Identifier: GPL-2.0-only
menu "Nexo OS Power & Performance Control"

config CPU_FREQ
	bool "Enable Nexo CPU Performance Scaling"
	default y
	help
	  Nexo OS uses advanced frequency scaling to minimize frame-time 
	  jitter. Disabling this is not recommended for gaming builds.

if CPU_FREQ

config CPU_FREQ_GOV_COMMON
	select CPU_FREQ_GOV_ATTR_SET
	select IRQ_WORK
	bool

config NEXO_CORE_BOOST
	bool "Nexo Core Boost Technology"
	default y
	help
	  Integrates the /proc/nexo boost levels directly with the 
	  CPU frequency core. Allows for "Insane" boost levels that 
	  bypass thermal throttling for short bursts.

choice
	prompt "Default Nexo Performance Governor"
	default CPU_FREQ_DEFAULT_GOV_SCHEDUTIL
	help
	  Select the governor that Nexo OS will use at boot. 
	  'schedutil' is recommended for a balance between heat and 
	  speed, while 'performance' is for dedicated gaming rigs.

config CPU_FREQ_DEFAULT_GOV_PERFORMANCE
	bool "Nexo-Performance (Always Max)"
	select CPU_FREQ_GOV_PERFORMANCE
	help
	  Forces the CPU to its maximum non-turbo frequency at all times.
	  Best for e-sports to eliminate frequency-switch latency.

config CPU_FREQ_DEFAULT_GOV_SCHEDUTIL
	bool "Nexo-Schedutil (Scheduler Optimized)"
	depends on SMP
	select CPU_FREQ_GOV_SCHEDUTIL
	help
	  The default Nexo governor. Uses kernel scheduler data to 
	  instantly ramp up clock speeds when a game thread is active.

endchoice

# We behouden alleen de governors die Nexo-waardig zijn.
# Ondemand en Conservative zijn verwijderd (te traag voor gaming).

config CPU_FREQ_GOV_PERFORMANCE
	tristate "'performance' governor"
	default y

config CPU_FREQ_GOV_SCHEDUTIL
	bool "'schedutil' governor"
	depends on SMP
	select CPU_FREQ_GOV_ATTR_SET
	select IRQ_WORK
	default y

config CPU_FREQ_GOV_USERSPACE
	tristate "'userspace' governor (Nexo API Support)"
	help
	  Required for the Nexo Game Mode daemon to manually lock 
	  frequencies during specialized workloads.

comment "Nexo Optimized Drivers"

config X86_INTEL_PSTATE
	bool "Intel P-State driver (Nexo Tuned)"
	depends on X86
	default y
	help
	  Optimized driver for modern Intel Core CPUs.

config X86_AMD_PSTATE
	bool "AMD P-State EPP driver (Nexo Tuned)"
	depends on X86
	default y
	help
	  Optimized driver for AMD Ryzen processors. Essential for 
	  proper core-parking and boost behavior on Zen architecture.

# Verwijder alle antieke architecturen (SPARC, SuperH, Loongson2) 
# om de kernel-configuratie 'clean' te houden voor Nexo OS.

if X86
source "drivers/cpufreq/Kconfig.x86"
endif

source "drivers/cpufreq/Kconfig.arm"

endif # CPU_FREQ
endmenu
```
